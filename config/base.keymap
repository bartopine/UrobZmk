#include <behaviors.dtsi>
#include <behaviors/num_word.dtsi> // Requires auto-layer module.
#include <dt-bindings/zmk/keys.h>
#ifdef CONFIG_WIRELESS
  #include <dt-bindings/zmk/bt.h>
  #include <dt-bindings/zmk/outputs.h>
#endif

#define HOST_OS 1
#include "helpers/helper.h"
#include "helpers/unicode-chars/french.dtsi"

#include "aliases.dtsi"
#include "behaviors.dtsi"
#include "combos.dtsi"
#include "leader.dtsi"
#include "mouse.dtsi"
#include "layers.dtsi"
